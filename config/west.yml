## config/west.yml
```yaml
manifest:
  remotes:
    # - name: moergo-sc
    #   url-base: https://github.com/moergo-sc
    - name: darknao
      url-base: https://github.com/darknao # darknao gerði moergo útgáfu af per layer per key rgb moddinu fyrir zmk
    - name: urob
      url-base: https://github.com/urob
  projects:
    - name: zmk
      remote: darknao
      # remote: moergo-sc
      # revision: main
      # revision: v25.04-beta.1
      # revision: rgb-layer-25.08 # 25.08 hjá moergo svarar til v0.3.0 hjá zmk
      revision: 8aeaaa66fbb4b94948c8763e06f1920ab0b69480
      import: app/west.yml
    - name: zmk-auto-layer
      remote: urob
      revision: b31aa0a357343535a56d535edd0c2ad64d3d7230
      path: modules/zmk/auto-layer
    - name: zmk-adaptive-key
      remote: urob
      revision: 01ccc22889714f276c930dc960a989f80c9e0680
      path: modules/zmk/adaptive-key
    - name: zmk-tri-state
      remote: urob
      revision: 9b7e1ac25f6dc733f62989fd064c6c5927e5e469
      path: modules/zmk/tri-state
    - name: zmk-helpers
      remote: urob
      revision: b1548efd28d2cc64b9506654e6883695c258190f
      path: modules/zmk/helpers
    - name: zmk-unicode
      remote: urob
      revision: 3e8ca744e5c3b6f430b3713f3e45b806ce89be7b
      path: modules/zmk/unicode

  self:
    path: config
```

## local-modules/gauntlet-behaviors/Kconfig
```kconfig
menu "Gauntlet Behaviors"

config GAUNTLET_BEHAVIOR_AUTO_LAYER_LOCAL
    bool "Gauntlet auto-layer local behavior"
    default y

endmenu
```

## modules-local/gauntlet-behaviors/Kconfig
```kconfig
menu "Gauntlet Behaviors"

config GAUNTLET_BEHAVIOR_AUTO_LAYER_LOCAL
    bool "Gauntlet auto-layer local behavior"
    default y

config GAUNTLET_BEHAVIOR_STICKY_LAYER_LOCAL
    bool "Gauntlet sticky-layer local behavior"
    default y

config GAUNTLET_BEHAVIOR_TRI_STATE_LOCAL
    bool "Gauntlet tri-state local behavior"
    default y

config GAUNTLET_STRICT_COMBOS
    bool "Gauntlet strict combos listener"
    default y

endmenu
```

## modules-local/gauntlet-behaviors/dts/bindings/behaviors/zmk,behavior-sticky-layer-local.yaml
```yaml
# Local sticky-layer copy for Gauntlet-specific cancel helpers.

description: Sticky layer behavior with explicit local cancel support

compatible: "zmk,behavior-sticky-layer-local"

include: one_param.yaml

properties:
  bindings:
    type: phandles
    required: true
  release-after-ms:
    type: int
    required: true
  quick-release:
    type: boolean
  lazy:
    type: boolean
  ignore-modifiers:
    type: boolean
```

## modules-local/gauntlet-behaviors/dts/bindings/gauntlet,ordered-combos.yaml
```yaml
# SPDX-License-Identifier: MIT

description: Gauntlet ordered combos container

compatible: "gauntlet,ordered-combos"

child-binding:
  description: "An ordered combo"

  properties:
    bindings:
      type: phandle-array
      required: true
    key-positions:
      type: array
      required: true
      description: Exact press order for this combo.
    timeout-ms:
      type: int
      default: 50
    require-prior-idle-ms:
      type: int
      default: -1
    slow-release:
      type: boolean
    layers:
      type: array
```

## modules-local/gauntlet-behaviors/dts/bindings/gauntlet,strict-combos.yaml
```yaml
# SPDX-License-Identifier: MIT

description: Gauntlet strict combos container

compatible: "gauntlet,strict-combos"

child-binding:
  description: "A strict combo"

  properties:
    bindings:
      type: phandle-array
      required: true
    key-positions:
      type: array
      required: true
    timeout-ms:
      type: int
      default: 50
    require-prior-idle-ms:
      type: int
      default: -1
    require-overlap-ms:
      type: int
      default: 0
    slow-release:
      type: boolean
    layers:
      type: array
```
